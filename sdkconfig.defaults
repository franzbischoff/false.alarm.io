## sdkconfig.defaults
```kconfig
# false.alarm.io - lean sdkconfig defaults (ESP-IDF)
#
# Rationale:
# - Keep only baseline knobs required by the current runtime architecture.
# - Source of data is SD card (SDSPI/FATFS), not LittleFS.
# - Minimize optional subsystems to reduce build/link overhead.
# - Preserve stable timing behavior for producer/consumer FreeRTOS tasks.

# Target / toolchain
CONFIG_IDF_TARGET="esp32"
CONFIG_IDF_TARGET_ESP32=y

# Partition table used by this project
CONFIG_PARTITION_TABLE_CUSTOM=y
CONFIG_PARTITION_TABLE_CUSTOM_FILENAME="partitions.csv"
CONFIG_PARTITION_TABLE_FILENAME="partitions.csv"
CONFIG_PARTITION_TABLE_OFFSET=0x8000
CONFIG_PARTITION_TABLE_MD5=y

# Build profile: size-optimized, assertions enabled for safer debug cycles
CONFIG_COMPILER_OPTIMIZATION_SIZE=y
CONFIG_COMPILER_OPTIMIZATION_ASSERTIONS_ENABLE=y
CONFIG_COMPILER_OPTIMIZATION_ASSERTION_LEVEL=2

# Keep C++ runtime lighter (exceptions/RTTI disabled)
# CONFIG_COMPILER_CXX_EXCEPTIONS is not set
# CONFIG_COMPILER_CXX_RTTI is not set

# FreeRTOS tick at 1kHz for precise sampling periods (e.g. 250Hz = 4ms)
CONFIG_FREERTOS_HZ=1000

# Logging: low default level to reduce runtime overhead in production
CONFIG_LOG_DEFAULT_LEVEL_ERROR=y
CONFIG_LOG_DEFAULT_LEVEL=1
CONFIG_LOG_MAXIMUM_LEVEL_VERBOSE=y
CONFIG_LOG_MAXIMUM_LEVEL=5

# High-resolution timer available for per-sample timestamps
CONFIG_ESP_TIME_FUNCS_USE_ESP_TIMER=y
CONFIG_ESP_TIME_FUNCS_USE_RTC_TIMER=y

# Security/network features not used in current offline data pipeline
# CONFIG_BT_ENABLED is not set
CONFIG_MBEDTLS_TLS_DISABLED=y

# Keep FATFS available (required by SD card VFS mount path)
CONFIG_FATFS_CODEPAGE_437=y
CONFIG_FATFS_CODEPAGE=437
CONFIG_FATFS_PER_FILE_CACHE=y

# Keep watchdogs active for robustness in long-running tasks
CONFIG_ESP_INT_WDT=y
CONFIG_ESP_TASK_WDT=y

# Boot behavior suitable for iterative development
CONFIG_ESP_SYSTEM_PANIC_PRINT_REBOOT=y
```

## sdkconfig.defaults.prod
```kconfig
# false.alarm.io - production size profile
#
# This profile is intentionally stricter than sdkconfig.defaults.
# Goal: reduce final firmware size for offline runtime (SD + MPX + alert).

# Base target/partition choices
CONFIG_IDF_TARGET="esp32"
CONFIG_IDF_TARGET_ESP32=y
CONFIG_PARTITION_TABLE_CUSTOM=y
CONFIG_PARTITION_TABLE_CUSTOM_FILENAME="partitions.csv"
CONFIG_PARTITION_TABLE_FILENAME="partitions.csv"
CONFIG_PARTITION_TABLE_OFFSET=0x10000
CONFIG_PARTITION_TABLE_MD5=y

# Compiler profile tuned for smallest binary
CONFIG_COMPILER_OPTIMIZATION_SIZE=y
CONFIG_COMPILER_OPTIMIZATION_ASSERTIONS_DISABLE=y
# CONFIG_COMPILER_OPTIMIZATION_ASSERTIONS_ENABLE is not set
CONFIG_COMPILER_OPTIMIZATION_ASSERTION_LEVEL=0

# Keep C++ runtime slim
# CONFIG_COMPILER_CXX_EXCEPTIONS is not set
# CONFIG_COMPILER_CXX_RTTI is not set

# Deterministic sampling timing (4ms at 250Hz)
CONFIG_FREERTOS_HZ=1000

# Keep only low default logging in production
CONFIG_LOG_DEFAULT_LEVEL_ERROR=y
CONFIG_LOG_DEFAULT_LEVEL=1
CONFIG_LOG_MAXIMUM_LEVEL_VERBOSE=y
CONFIG_LOG_MAXIMUM_LEVEL=5

# Keep bootloader compact so it fits before partition table offset (0x10000)
CONFIG_BOOTLOADER_COMPILER_OPTIMIZATION_SIZE=y
CONFIG_BOOTLOADER_LOG_LEVEL_NONE=n
CONFIG_BOOTLOADER_LOG_LEVEL_ERROR=y
CONFIG_BOOTLOADER_LOG_LEVEL_WARN=n
CONFIG_BOOTLOADER_LOG_LEVEL_INFO=n
CONFIG_BOOTLOADER_LOG_LEVEL_DEBUG=n
CONFIG_BOOTLOADER_LOG_LEVEL_VERBOSE=n
CONFIG_BOOTLOADER_LOG_LEVEL=1

# Timestamp support for queued samples
CONFIG_ESP_TIME_FUNCS_USE_ESP_TIMER=y
CONFIG_ESP_TIME_FUNCS_USE_RTC_TIMER=y

# SD card path needs FATFS
CONFIG_FATFS_CODEPAGE_437=y
CONFIG_FATFS_CODEPAGE=437
CONFIG_FATFS_PER_FILE_CACHE=y

# Keep watchdog protection in long-running runtime tasks
CONFIG_ESP_INT_WDT=y
CONFIG_ESP_TASK_WDT=y
CONFIG_ESP_TASK_WDT_TIMEOUT_S=5
CONFIG_ESP_TASK_WDT_CHECK_IDLE_TASK_CPU0=y
# CONFIG_ESP_TASK_WDT_CHECK_IDLE_TASK_CPU1 is not set
CONFIG_ESP_SYSTEM_PANIC_PRINT_REBOOT=y

# Production profile is offline for now: disable network stack and related features
# CONFIG_ESP_WIFI_ENABLED is not set
# CONFIG_LWIP_ENABLE is not set
# CONFIG_ESP_TLS_USING_MBEDTLS is not set
CONFIG_MBEDTLS_TLS_DISABLED=y
# CONFIG_ESP_HTTP_CLIENT_ENABLE_HTTPS is not set
# CONFIG_MQTT_PROTOCOL_311 is not set
# CONFIG_MQTT_TRANSPORT_SSL is not set
# CONFIG_MQTT_TRANSPORT_WEBSOCKET is not set
# CONFIG_MQTT_TRANSPORT_WEBSOCKET_SECURE is not set
# CONFIG_BT_ENABLED is not set
```

## sdkconfig.defaults.stats
```kconfig
# false.alarm.io - production profile with FreeRTOS runtime stats
#
# Based on sdkconfig.defaults.prod but with CONFIG_FREERTOS_GENERATE_RUN_TIME_STATS enabled
# to measure CPU load per task per core.

# Base target/partition choices
CONFIG_IDF_TARGET="esp32"
CONFIG_IDF_TARGET_ESP32=y
CONFIG_PARTITION_TABLE_CUSTOM=y
CONFIG_PARTITION_TABLE_CUSTOM_FILENAME="partitions.csv"
CONFIG_PARTITION_TABLE_FILENAME="partitions.csv"
CONFIG_PARTITION_TABLE_OFFSET=0x10000
CONFIG_PARTITION_TABLE_MD5=y

# Compiler profile tuned for smallest binary
CONFIG_COMPILER_OPTIMIZATION_SIZE=y
CONFIG_COMPILER_OPTIMIZATION_ASSERTIONS_DISABLE=y
# CONFIG_COMPILER_OPTIMIZATION_ASSERTIONS_ENABLE is not set
CONFIG_COMPILER_OPTIMIZATION_ASSERTION_LEVEL=0

# Keep C++ runtime slim
# CONFIG_COMPILER_CXX_EXCEPTIONS is not set
# CONFIG_COMPILER_CXX_RTTI is not set

# Deterministic sampling timing (4ms at 250Hz)
CONFIG_FREERTOS_HZ=1000

# Enable FreeRTOS runtime statistics for per-task CPU load measurement
CONFIG_FREERTOS_USE_TRACE_FACILITY=y
CONFIG_FREERTOS_GENERATE_RUN_TIME_STATS=y

# Keep only low default logging in production
CONFIG_LOG_DEFAULT_LEVEL_ERROR=y
CONFIG_LOG_DEFAULT_LEVEL=1
CONFIG_LOG_MAXIMUM_LEVEL_VERBOSE=y
CONFIG_LOG_MAXIMUM_LEVEL=5

# Keep bootloader compact so it fits before partition table offset (0x10000)
CONFIG_BOOTLOADER_COMPILER_OPTIMIZATION_SIZE=y
CONFIG_BOOTLOADER_LOG_LEVEL_NONE=n
CONFIG_BOOTLOADER_LOG_LEVEL_ERROR=y
CONFIG_BOOTLOADER_LOG_LEVEL_WARN=n
CONFIG_BOOTLOADER_LOG_LEVEL_INFO=n
CONFIG_BOOTLOADER_LOG_LEVEL_DEBUG=n
CONFIG_BOOTLOADER_LOG_LEVEL_VERBOSE=n
CONFIG_BOOTLOADER_LOG_LEVEL=1

# Timestamp support for queued samples
CONFIG_ESP_TIME_FUNCS_USE_ESP_TIMER=y
CONFIG_ESP_TIME_FUNCS_USE_RTC_TIMER=y

# SD card path needs FATFS
CONFIG_FATFS_CODEPAGE_437=y
CONFIG_FATFS_CODEPAGE=437
```

## sdkconfig.defaults.systemview
```kconfig
# false.alarm.io - SystemView profiling profile
#
# Baseado no perfil de producao, com trace via JTAG para analise multicore.

# Base target/partition choices
CONFIG_IDF_TARGET="esp32"
CONFIG_IDF_TARGET_ESP32=y
CONFIG_PARTITION_TABLE_CUSTOM=y
CONFIG_PARTITION_TABLE_CUSTOM_FILENAME="partitions.csv"
CONFIG_PARTITION_TABLE_FILENAME="partitions.csv"
CONFIG_PARTITION_TABLE_OFFSET=0x10000
CONFIG_PARTITION_TABLE_MD5=y

# Compiler profile tuned for smallest binary for safe flash layout
CONFIG_COMPILER_OPTIMIZATION_SIZE=y
CONFIG_COMPILER_OPTIMIZATION_ASSERTIONS_DISABLE=y
CONFIG_COMPILER_OPTIMIZATION_ASSERTION_LEVEL=0

# Keep C++ runtime slim
# CONFIG_COMPILER_CXX_EXCEPTIONS is not set
# CONFIG_COMPILER_CXX_RTTI is not set

# Deterministic sampling timing (4ms at 250Hz)
CONFIG_FREERTOS_HZ=1000

# FreeRTOS runtime stats and trace hooks
CONFIG_FREERTOS_USE_TRACE_FACILITY=y
CONFIG_FREERTOS_GENERATE_RUN_TIME_STATS=y

# AppTrace over JTAG (used by SystemView/App Trace capture)
CONFIG_APPTRACE_DEST_JTAG=y
# CONFIG_APPTRACE_DEST_NONE is not set
# CONFIG_APPTRACE_DEST_UART1 is not set
# CONFIG_APPTRACE_DEST_UART2 is not set
CONFIG_APPTRACE_DEST_UART_NONE=y
CONFIG_APPTRACE_UART_TASK_PRIO=1
CONFIG_APPTRACE_DEST_TRAX=y
CONFIG_APPTRACE_ENABLE=y
CONFIG_APPTRACE_SV_ENABLE=y
CONFIG_APPTRACE_LOCK_ENABLE=y

# ESP32 legacy apptrace backend for TRAX
CONFIG_ESP32_APPTRACE_DEST_TRAX=y
# CONFIG_ESP32_APPTRACE_DEST_NONE is not set
CONFIG_ESP32_APPTRACE_ENABLE=y
CONFIG_SYSVIEW_ENABLE=y
CONFIG_ESP32_APPTRACE_LOCK_ENABLE=y

# Keep bootloader compact so it fits before partition table offset (0x8000)
CONFIG_BOOTLOADER_COMPILER_OPTIMIZATION_SIZE=y
CONFIG_BOOTLOADER_LOG_LEVEL_NONE=n
CONFIG_BOOTLOADER_LOG_LEVEL_ERROR=y
CONFIG_BOOTLOADER_LOG_LEVEL_WARN=n
CONFIG_BOOTLOADER_LOG_LEVEL_INFO=n
CONFIG_BOOTLOADER_LOG_LEVEL_DEBUG=n
CONFIG_BOOTLOADER_LOG_LEVEL_VERBOSE=n
CONFIG_BOOTLOADER_LOG_LEVEL=1

# Timestamp support for queued samples
CONFIG_ESP_TIME_FUNCS_USE_ESP_TIMER=y
CONFIG_ESP_TIME_FUNCS_USE_RTC_TIMER=y

# SD card path needs FATFS
CONFIG_FATFS_CODEPAGE_437=y
CONFIG_FATFS_CODEPAGE=437
CONFIG_FATFS_PER_FILE_CACHE=y

# Disable watchdogs in profiling mode to avoid JTAG halt/resume reset loops
# CONFIG_ESP_INT_WDT is not set
# CONFIG_ESP_TASK_WDT is not set
CONFIG_ESP_SYSTEM_PANIC_PRINT_REBOOT=y
```
